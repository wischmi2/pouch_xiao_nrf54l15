## CMakeLists.txt
```
# SPDX-License-Identifier: Apache-2.0

cmake_minimum_required(VERSION 3.20.0)
find_package(Zephyr REQUIRED HINTS $ENV{ZEPHYR_BASE})
project(gateway)

target_include_directories(app PRIVATE include ${CMAKE_CURRENT_BINARY_DIR})

target_sources(app PRIVATE
  src/fatal_error.c
  src/main.c
  git_describe.h
)

file(WRITE ${CMAKE_CURRENT_BINARY_DIR}/mk-git-describe.cmake
  "execute_process(\n"
  "  COMMAND git describe --always --dirty\n"
  "  WORKING_DIRECTORY ${CMAKE_CURRENT_LIST_DIR}\n"
  "  OUTPUT_VARIABLE GIT_DESCRIBE\n"
  "  OUTPUT_STRIP_TRAILING_WHITESPACE\n"
  "  ERROR_QUIET\n"
  ")\n"
  "if(NOT GIT_DESCRIBE)\n"
  "  set(GIT_DESCRIBE unknown)\n"
  "endif()\n"
  "file(WRITE ${CMAKE_CURRENT_BINARY_DIR}/git_describe.h \"#define GIT_DESCRIBE \${GIT_DESCRIBE}\\n\")\n")

add_custom_command(OUTPUT git_describe.h always_run
  COMMAND ${CMAKE_COMMAND} -P ${CMAKE_CURRENT_BINARY_DIR}/mk-git-describe.cmake
  WORKING_DIRECTORY ${CMAKE_CURRENT_LIST_DIR})
```

## prj.conf
```kconfig
CONFIG_POUCH_GATEWAY=y

CONFIG_BT=y
CONFIG_BT_CENTRAL=y
CONFIG_BT_MAX_CONN=16
CONFIG_BT_GATT_CLIENT=y
CONFIG_BT_GATT_CACHING=n
CONFIG_BT_GATT_AUTO_UPDATE_MTU=y
CONFIG_BT_L2CAP_TX_MTU=247
CONFIG_BT_BUF_ACL_TX_SIZE=251
CONFIG_BT_BUF_ACL_RX_SIZE=251

CONFIG_COAP_INIT_ACK_TIMEOUT_MS=3000

CONFIG_LOG=y

# Settings subsystem
CONFIG_FCB=y
CONFIG_FLASH=y
CONFIG_FLASH_MAP=y

CONFIG_SETTINGS=y
CONFIG_SETTINGS_FCB=y

# Application
CONFIG_GOLIOTH_SAMPLE_COMMON=y
CONFIG_GOLIOTH_SAMPLE_SETTINGS_SHELL=y

# Golioth Firmware SDK with all dependencies
CONFIG_GOLIOTH_FIRMWARE_SDK=y
CONFIG_GOLIOTH_GATEWAY=y

# Golioth logging backend
CONFIG_LOG_MODE_DEFERRED=y
CONFIG_LOG_BACKEND_GOLIOTH=y

# Application
CONFIG_MAIN_STACK_SIZE=2048
CONFIG_SYSTEM_WORKQUEUE_STACK_SIZE=2048
CONFIG_SHELL=y

# Pouch BLE GATT Transport
CONFIG_POUCH_TRANSPORT_GATT_COMMON=y

CONFIG_ZVFS_EVENTFD_MAX=11

# Pouch server certificate parse
CONFIG_MBEDTLS_PSA_CRYPTO_C=y
CONFIG_MBEDTLS_PEM_CERTIFICATE_FORMAT=y
CONFIG_PSA_WANT_ALG_ECDSA=y
CONFIG_PSA_WANT_ALG_SHA_384=y
CONFIG_PSA_WANT_ECC_SECP_R1_256=y
CONFIG_PSA_WANT_ECC_SECP_R1_384=y
CONFIG_PSA_WANT_KEY_TYPE_ECC_PUBLIC_KEY=y

# Bluetooth secure connections
CONFIG_BT_SMP=y
CONFIG_BT_SECURITY_ERR_TO_STR=y
# The gateway may see multiple XIAO nodes. Keep enough bond slots so pairing
# one node does not evict or conflict with another node.
CONFIG_BT_MAX_PAIRED=4
CONFIG_MBEDTLS_ECP_C=y
# This option is implied by BT_SMP and breaks secp384r1 support
CONFIG_MBEDTLS_PSA_P256M_DRIVER_ENABLED=n
```

## boards/frdm_rw612_wifi.conf
```kconfig
# Extra configuration file for using NXP frdm_rw612 with WiFi instead of Ethernet
#   To use, add as extra conf file:
#   west build -p -b frdm_rw612 <path_to>/gateway -- -DEXTRA_CONF_FILE=<path_to>/gateway/boards/frdm_rw612_wifi.conf

CONFIG_GOLIOTH_SAMPLE_WIFI=y
CONFIG_WIFI=y
CONFIG_WIFI_NXP=y

CONFIG_NET_L2_ETHERNET=y
CONFIG_NET_IPV4=y
CONFIG_NET_IF_MAX_IPV4_COUNT=3
CONFIG_NET_PKT_RX_COUNT=36
CONFIG_NET_PKT_TX_COUNT=36
CONFIG_NET_BUF_RX_COUNT=40
CONFIG_NET_BUF_TX_COUNT=40
CONFIG_NET_BUF_DATA_SIZE=1744

# Runtime provisioning for WiFi credentials
CONFIG_NET_L2_WIFI_SHELL=y

# Use the server certificate chain downloaded from Golioth at runtime. The
# node encrypts Pouch uplinks to this public key, so it must match the cloud.
CONFIG_POUCH_GATEWAY_SERVER_CERT_BUILTIN=n
```

## src/main.c
```c
/*
 * Copyright (c) 2025 Golioth, Inc.
 *
 * SPDX-License-Identifier: Apache-2.0
 */

#include <zephyr/bluetooth/bluetooth.h>
#include <zephyr/bluetooth/conn.h>
#include <zephyr/bluetooth/hci.h>
#include <zephyr/net/net_if.h>
#include <zephyr/net/dhcpv4.h>
#include <zephyr/drivers/gpio.h>

#include <golioth/client.h>
#include <golioth/gateway.h>
#include <samples/common/sample_credentials.h>

#include <pouch/transport/gatt/common/types.h>

#include <pouch/gateway/bt/bond.h>
#include <pouch/gateway/bt/connect.h>
#include <pouch/gateway/bt/scan.h>
#include <pouch/gateway/cert.h>
#include <pouch/gateway/downlink.h>
#include <pouch/gateway/uplink.h>

#include <git_describe.h>

#include <zephyr/logging/log.h>
LOG_MODULE_REGISTER(main);

struct golioth_client *client;

struct net_wait_data
{
    struct k_sem sem;
    struct net_mgmt_event_callback cb;
};

static const struct gpio_dt_spec button = GPIO_DT_SPEC_GET_OR(DT_ALIAS(sw0), gpios, {});
static struct gpio_callback button_cb_data;
static struct bt_conn *default_conn;

static const k_timeout_t bonding_timeout = K_SECONDS(30);
static const bt_security_t bt_security =
    IS_ENABLED(CONFIG_POUCH_GATEWAY_GATT_SCAN_FILTER_BONDED) ? BT_SECURITY_L4 : BT_SECURITY_L2;

static void button_pressed(const struct device *dev, struct gpio_callback *cb, uint32_t pins)
{
    if (default_conn)
    {
        LOG_INF("Confirming passkey");
        bt_conn_auth_passkey_confirm(default_conn);
    }
    else if (pouch_gateway_bonding_is_enabled())
    {
        LOG_WRN("Bonding already enabled");
    }
    else
    {
        pouch_gateway_bonding_enable(bonding_timeout);
    }
}

#ifdef CONFIG_POUCH_GATEWAY_CLOUD

static K_SEM_DEFINE(connected, 0, 1);

static void on_client_event(struct golioth_client *client,
                            enum golioth_client_event event,
                            void *arg)
{
    bool is_connected = (event == GOLIOTH_CLIENT_EVENT_CONNECTED);
    if (is_connected)
    {
        k_sem_give(&connected);
    }
    LOG_INF("Golioth client %s", is_connected ? "connected" : "disconnected");
}

static void connect_golioth_client(void)
{
    const struct golioth_client_config *client_config = golioth_sample_credentials_get();
    if (client_config == NULL || client_config->credentials.psk.psk_id_len == 0
        || client_config->credentials.psk.psk_len == 0)
    {
        LOG_ERR("No credentials found.");
        LOG_ERR(
            "Please store your credentials with the following commands, then reboot the device.");
        LOG_ERR("\tsettings set golioth/psk-id <your-psk-id>");
        LOG_ERR("\tsettings set golioth/psk <your-psk>");
        return;
    }

    client = golioth_client_create(client_config);

    golioth_client_register_event_callback(client, on_client_event, NULL);
}

static void event_cb_handler(struct net_mgmt_event_callback *cb,
                             uint64_t mgmt_event,
                             struct net_if *iface)
{
    struct net_wait_data *wait = CONTAINER_OF(cb, struct net_wait_data, cb);

    if (mgmt_event == cb->event_mask)
    {
        k_sem_give(&wait->sem);
    }
}

static void wait_for_net_event(struct net_if *iface, uint64_t event)
{
    struct net_wait_data wait;

    wait.cb.handler = event_cb_handler;
    wait.cb.event_mask = event;

    k_sem_init(&wait.sem, 0, 1);
    net_mgmt_add_event_callback(&wait.cb);

    k_sem_take(&wait.sem, K_FOREVER);

    net_mgmt_del_event_callback(&wait.cb);
}

static void connect_to_cloud(void)
{
    struct net_if *iface = net_if_get_default();

    if (!net_if_is_up(iface))
    {
        LOG_INF("Bringing up network interface (%p)", (void *) iface);
        int ret = net_if_up(iface);
        if ((ret < 0) && (ret != -EALREADY))
        {
            LOG_ERR("Failed to bring up network interface: %d", ret);
            return;
        }
    }

    if (IS_ENABLED(CONFIG_NET_L2_ETHERNET) && IS_ENABLED(CONFIG_NET_DHCPV4))
    {
        net_dhcpv4_start(net_if_get_default());
    }
    else if (IS_ENABLED(CONFIG_MODEM))
    {
        LOG_INF("Waiting to obtain IP address");
        wait_for_net_event(iface,
                           IS_ENABLED(DNS_SERVER_IP_ADDRESSES) ? NET_EVENT_DNS_SERVER_ADD
                                                               : NET_EVENT_IPV4_ADDR_ADD);
    }

    connect_golioth_client();
    k_sem_take(&connected, K_FOREVER);
}

#else /* CONFIG_POUCH_GATEWAY_CLOUD */

static inline void connect_to_cloud(void) {}

#endif /* CONFIG_POUCH_GATEWAY_CLOUD */

static void bt_connected(struct bt_conn *conn, uint8_t err)
{
    char addr[BT_ADDR_LE_STR_LEN];

    bt_addr_le_to_str(bt_conn_get_dst(conn), addr, sizeof(addr));

    if (err)
    {
        LOG_ERR("Failed to connect to %s %u %s", addr, err, bt_hci_err_to_str(err));

        pouch_gateway_scan_peer_cooldown(bt_conn_get_dst(conn));
        bt_conn_unref(conn);

        pouch_gateway_scan_start();
        return;
    }

    LOG_INF("Connected: %s", addr);
    default_conn = conn;

    err = bt_conn_set_security(conn, bt_security);
    if (err)
    {
        LOG_ERR("Failed to set security (%d).", err);

        pouch_gateway_scan_peer_cooldown(bt_conn_get_dst(conn));
        bt_conn_disconnect(conn, BT_HCI_ERR_REMOTE_USER_TERM_CONN);
        return;
    }
}

static void bt_disconnected(struct bt_conn *conn, uint8_t reason)
{
    char addr[BT_ADDR_LE_STR_LEN];

    default_conn = NULL;

    bt_addr_le_to_str(bt_conn_get_dst(conn), addr, sizeof(addr));
    LOG_INF("Disconnected: %s, reason 0x%02x %s", addr, reason, bt_hci_err_to_str(reason));

    pouch_gateway_bt_stop(conn);

    bt_conn_unref(conn);

    pouch_gateway_scan_start();
}

static void security_changed(struct bt_conn *conn, bt_security_t level, enum bt_security_err err)
{
    char addr[BT_ADDR_LE_STR_LEN];
    bt_addr_le_to_str(bt_conn_get_dst(conn), addr, sizeof(addr));

    if (err)
    {
        LOG_ERR("BT security change failed for %s. Current level: %d, err: %s(%u)",
                addr,
                level,
                bt_security_err_to_str(err),
                err);

        struct bt_conn_info info;
        bt_conn_get_info(conn, &info);

        pouch_gateway_scan_peer_cooldown(info.le.dst);
        LOG_WRN("Removing stale bond for %s, id %u", addr, info.id);
        bt_unpair(info.id, info.le.dst);
        bt_conn_disconnect(conn, BT_HCI_ERR_INSUFFICIENT_SECURITY);
    }
    else
    {
        LOG_INF("BT security changed for %s to level %u", addr, level);
        pouch_gateway_scan_peer_cooldown_clear(bt_conn_get_dst(conn));

        pouch_gateway_bt_start(conn);
    }
}

BT_CONN_CB_DEFINE(conn_callbacks) = {
    .connected = bt_connected,
    .disconnected = bt_disconnected,
    .security_changed = security_changed,
};

static void auth_cancel(struct bt_conn *conn)
{
    char addr[BT_ADDR_LE_STR_LEN];

    bt_addr_le_to_str(bt_conn_get_dst(conn), addr, sizeof(addr));

    LOG_INF("Pairing cancelled: %s", addr);
}

static void auth_passkey_confirm(struct bt_conn *conn, unsigned int passkey)
{
    char addr[BT_ADDR_LE_STR_LEN];
    char passkey_str[7];

    bt_addr_le_to_str(bt_conn_get_dst(conn), addr, sizeof(addr));

    snprintk(passkey_str, 7, "%06u", passkey);

    LOG_INF("Confirm passkey for %s: %s", addr, passkey_str);

    if (IS_ENABLED(CONFIG_SAMPLE_POUCH_GATEWAY_BT_AUTO_CONFIRM))
    {
        LOG_INF("Confirming passkey");
        bt_conn_auth_passkey_confirm(conn);
    }
}

static void auth_passkey_display(struct bt_conn *conn, unsigned int passkey)
{
    char addr[BT_ADDR_LE_STR_LEN];
    char passkey_str[7];

    bt_addr_le_to_str(bt_conn_get_dst(conn), addr, sizeof(addr));

    snprintk(passkey_str, 7, "%06u", passkey);

    LOG_INF("Passkey for %s: %s", addr, passkey_str);
}

static struct bt_conn_auth_cb auth_cb = {
    .cancel = auth_cancel,

    .passkey_confirm =
        IS_ENABLED(CONFIG_POUCH_GATEWAY_GATT_SCAN_FILTER_BONDED) ? auth_passkey_confirm : NULL,
    .passkey_display =
        IS_ENABLED(CONFIG_POUCH_GATEWAY_GATT_SCAN_FILTER_BONDED) ? auth_passkey_display : NULL,
};

static void pairing_complete(struct bt_conn *conn, bool bonded)
{
    char addr[BT_ADDR_LE_STR_LEN];

    bt_addr_le_to_str(bt_conn_get_dst(conn), addr, sizeof(addr));
    LOG_INF("Pairing complete for %s, bonded %d", addr, (int) bonded);
}

static void pairing_failed(struct bt_conn *conn, enum bt_security_err reason)
{
    char addr[BT_ADDR_LE_STR_LEN];

    bt_addr_le_to_str(bt_conn_get_dst(conn), addr, sizeof(addr));
    LOG_WRN("Pairing failed for %s: %s(%u). Disconnecting.",
            addr,
            bt_security_err_to_str(reason),
            reason);

    pouch_gateway_scan_peer_cooldown(bt_conn_get_dst(conn));
    bt_conn_disconnect(conn,
                       (reason == BT_SECURITY_ERR_PAIR_NOT_ALLOWED) ? BT_HCI_ERR_PAIRING_NOT_ALLOWED
                                                                    : BT_HCI_ERR_AUTH_FAIL);
}

static struct bt_conn_auth_info_cb auth_info_cb = {
    .pairing_complete = pairing_complete,
    .pairing_failed = pairing_failed,
};

void pouch_gateway_bt_finished(struct bt_conn *conn)
{
    bt_conn_disconnect(conn, BT_HCI_ERR_REMOTE_USER_TERM_CONN);
}

int main(void)
{
    int err;

    LOG_INF("Gateway Version: " STRINGIFY(GIT_DESCRIBE));
    LOG_INF("Pouch BLE Transport Protocol Version: %d", POUCH_GATT_VERSION);

    if (DT_HAS_ALIAS(sw0))
    {
        LOG_INF("Set up button at %s pin %d", button.port->name, button.pin);

        err = gpio_pin_configure_dt(&button, GPIO_INPUT);
        if (err < 0)
        {
            LOG_ERR("Could not initialize Button");
        }

        err = gpio_pin_interrupt_configure_dt(&button, GPIO_INT_EDGE_TO_ACTIVE);
        if (err)
        {
            LOG_ERR("Error %d: failed to configure interrupt on %s pin %d",
                    err,
                    button.port->name,
                    button.pin);
            return 0;
        }

        gpio_init_callback(&button_cb_data, button_pressed, BIT(button.pin));
        gpio_add_callback(button.port, &button_cb_data);
    }

    connect_to_cloud();

    pouch_gateway_cert_module_on_connected(client);
    pouch_gateway_uplink_module_init(client);
    pouch_gateway_downlink_module_init(client);

    err = bt_enable(NULL);
    if (err)
    {
        LOG_ERR("Bluetooth init failed (err %d)", err);
        return err;
    }

    if (IS_ENABLED(CONFIG_BT_SMP))
    {
        bt_conn_auth_cb_register(&auth_cb);
        bt_conn_auth_info_cb_register(&auth_info_cb);
    }

    LOG_INF("Bluetooth initialized");

    if (IS_ENABLED(CONFIG_SAMPLE_POUCH_GATEWAY_BT_AUTO_BOND))
    {
        pouch_gateway_bonding_enable(K_FOREVER);
    }

    pouch_gateway_scan_start();

#ifdef CONFIG_POUCH_GATEWAY_CLOUD
    while (true)
    {
        k_sem_take(&connected, K_FOREVER);
        pouch_gateway_cert_module_on_connected(client);
    }
#endif

    return 0;
}
```

## boards/bsim_device/board.yml
```yaml
boards:
  - name: bsim_device
    full_name: BabbleSim device simulator
    vendor: zephyr
    socs:
      - name: native
        variants:
          - name: empty
          - name: handbrake
          - name: pause_simu
          - name: time_monitor
```
